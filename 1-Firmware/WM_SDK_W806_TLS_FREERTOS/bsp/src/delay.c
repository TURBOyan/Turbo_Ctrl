/*
 * delay.c
 *
 *  Created on: Oct 27, 2021
 *      Author: jiangyuanyuan
 */
 
 
/************************************1-头文件**********************************/
#include "delay.h"
/**************************************end*************************************/

/************************************2-宏定义**********************************/

/*************************************end**************************************/

/***********************************3-变量定义*********************************/

/*************************************End**************************************/

/**********************************4-初始化函数********************************/

/**************************************end*************************************/

/***********************************5-回调函数*********************************/

/**************************************end*************************************/

/*********************************6-API接口函数********************************/
void delay_us(uint32_t nus)
{  
  uint32_t i,j;  
  for(i = 0; i < nus; i++)
  {     
		j=51;   //change it  for timing adjustment
		while(j--)
		{  
			__NOP();  // nop's may be added or removed for timing  
		} 
  }
}

void delay_ms(uint16_t nms)
{
  uint16_t i,j,k; 
	for(i = 0; i < nms; i++)
	{
		for(j = 0; j < 1000; j++)
		{     
			k=51;   //change it  for timing adjustment
			while(k--)
			{  
				__NOP();  // nop's may be added or removed for timing  
			} 
		}
	}	
}

void HAL_Delayms(uint32_t ms)
{
	HAL_Delay(ms);
}
/**************************************end*************************************/